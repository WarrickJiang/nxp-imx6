## conf/layer.conf
```bitbake
#
# Copyright (C) 2016-2017 Wind River Systems, Inc.
#

# We have a conf and classes directory, add to BBPATH
BBPATH =. "${LAYERDIR}:"

# We have a packages directory, add to BBFILES
BBFILES += "${LAYERDIR}/recipes-*/*/*.bb \
	${LAYERDIR}/recipes-*/*/*.bbappend \
	${LAYERDIR}/classes/*.bbclass"

BBFILE_COLLECTIONS += "wr-nxp-imx6"
BBFILE_PATTERN_wr-nxp-imx6 := "^${LAYERDIR}/"
BBFILE_PRIORITY_wr-nxp-imx6 = "7"

PREFERRED_PROVIDER_virtual/kernel ?= "linux-yocto"

# This should only be incremented on significant changes that will
# cause compatibility issues with other layers
LAYERVERSION_wr-nxp-imx6 = "1"

LAYERDEPENDS_wr-nxp-imx6 = "core"

FLATPAK_ARCH="arm"

DEFAULT_TIMEZONE = "Universal"
```

## conf/machine/nxp-imx6.conf
```bitbake
#@TYPE: Machine
#@NAME: nxp-imx6
#@DESCRIPTION: nxp-imx6

DEFAULTTUNE ?= "armv7athf-neon"

require conf/machine/include/tune-cortexa9.inc

MACHINE_FEATURES = "ext3 pci usbgadget usbhost vfat alsa touchscreen"

KERNEL_IMAGETYPE = "zImage"
KERNEL_DEVICETREE = "imx6sx-seco-b08-full-lvds7.dtb \
                     imx6sx-seco-b08-full-rgb7.dtb \
                     imx6sx-seco-c23-full.dtb \
"
SECO_DEFAULT_DTB = "imx6sx-seco-c23-full.dtb"

SERIAL_CONSOLE = "115200 ttymxc0"

UBOOT_CONFIG ??= "imx6sxsecob08"

UBOOT_CONFIG[imx6qsabresd] = "mx6qsabresd_config"
UBOOT_CONFIG[imx6sxsabresd] = "mx6sxsabresd_config"
UBOOT_CONFIG[imx6sxsecob08] = "seco_b08_config"
UBOOT_MAKE_TARGET ?= "u-boot.imx"
UBOOT_BINARY = "u-boot.imx"

MACHINE_EXTRA_RRECOMMENDS = " kernel-modules kernel-devicetree"
IMAGE_FSTYPES += "tar.bz2"
IMAGE_INSTALL_append = " kernel-devicetree kernel-image-zimage"

IMAGE_BOOT_FILES ?= "zImage imx6sx-seco-b08-full-lvds7.dtb imx6sx-seco-b08-full-rgb7.dtb boot.scr"

EXTRA_IMAGEDEPENDS_append_nxp-imx6 += "u-boot-imx-uenv u-boot-imx"

OSTREE_KERNEL_ARGS = "rw rootwait rootdelay=2"
```
